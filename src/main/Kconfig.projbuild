## src/main/Kconfig.projbuild
```kconfig
menu "USB Override"

    config TINYUSB_HID_ENABLED
        bool "Enable TinyUSB HID feature"
        default n
        help
            Enable TinyUSB HID feature.

    config TINYUSB_HID_BUFSIZE
        int "HID buffer size Should be sufficient to hold ID (if any) + Data"
        default 16
        depends on TINYUSB_HID_ENABLED
        help
            HID buffer size Should be sufficient to hold ID (if any) + Data

endmenu
```
